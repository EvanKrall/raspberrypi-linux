#include <dt-bindings/interrupt-controller/irq.h>

/dts-v1/;
/plugin/;

/ {
    compatible = "brcm,bcm2835";

    fragment@0 {
        target = <&i2c1>;
        __overlay__ {
            #address-cells = <1>;
            #size-cells = <0>;
            status = "okay";

            charger@6a {
                compatible = "ti,bq25895";
                reg = <0x6a>;

                interrupt-parent = <&gpio>;
                interrupts = <4 IRQ_TYPE_EDGE_FALLING>;

                ti,battery-regulation-voltage = <4100000>; // lower than standard, to prolong battery life.
                ti,charge-current = <1000000>;
                ti,termination-current = <50000>;
                ti,precharge-current = <128000>;
                ti,minimum-sys-voltage = <3500000>;
                ti,boost-voltage = <5000000>;
                ti,boost-max-current = <1000000>;

                ti,use-ilim-pin;
                ti,thermal-regulation-threshold = <120>;
            };
        };
    };
};