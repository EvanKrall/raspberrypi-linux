/dts-v1/;
/plugin/;

/ {
    compatible = "brcm,bcm2835";

    fragment@0 {
        target = <&i2c1>;
        __overlay__ {
            #address-cells = <1>;
            #size-cells = <0>;
            status = "okay";


            rv8263: rtc@51 {
                compatible = "microcrystal,rv8263";
                reg = <0x51>;
                // quartz-load-femtofarads = <12500>;
            };
        };
    };
};