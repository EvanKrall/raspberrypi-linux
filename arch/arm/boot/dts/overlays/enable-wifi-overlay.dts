/dts-v1/;
/plugin/;

/{
	compatible = "brcm,bcm2835";

	fragment@0 {
		target = <&mmc>;
		__overlay__ {
			status = "enabled";
		};
	};

	fragment@1 {
		target = <&mmcnr>;
		__overlay__ {
			status = "disabled";
		};
	};
};
